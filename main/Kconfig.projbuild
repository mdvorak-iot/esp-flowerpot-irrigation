## main/Kconfig.projbuild
```kconfig
menu "Application config"
    config APP_DEVICE_NAME
        string "RainMaker device name"
        default "Flower Pot"

    config APP_DEVICE_TYPE
        string "RainMaker device type"
        default "esp.device.temperature-sensor"

    config APP_CONTROL_LOOP_INTERVAL
        int "Main control loop interval in ms"
        default 10000

    config APP_NTP_TZ
        string "TimeZone string"
        default "CET-1CEST,M3.5.0,M10.5.0/3" # Europe/Prague

    config APP_NTP_SERVER
        string "NTP server"
        default "cz.pool.ntp.org"
endmenu

menu "Hardware config"
    config HW_BUTTON_PIN
        int "Switch button pin"
        default 19
        help
            Start/stop irrigation, wifi provision and factory reset.

    # Valve
    menuconfig HW_VALVE_ENABLE
        bool "Water Valve"
        default y

    config HW_VALVE_POWER_PIN
        depends on HW_VALVE_ENABLE
        int "Valve power pin"
        default 26
        help
            Open normally closed valve pin.

    # Temperature
    menuconfig HW_DS18B20_ENABLE
        bool "Temperature Sensor"
        default y

    config HW_DS18B20_PIN
        depends on HW_DS18B20_ENABLE
        int "Temperature sensors data pin"
        default 27

    # Soil probe
    menuconfig HW_SOIL_PROBE_ENABLE
        bool "Soil Probe"
        default y

    config HW_SOIL_PROBE_TOUCH_PAD
        depends on HW_SOIL_PROBE_ENABLE
        int "Soil humidity sensor touch pad channel"
        default 9
        help
            Look in docs, what channel corresponds to which pin.

    config HW_SOIL_PROBE_MIN
        depends on HW_SOIL_PROBE_ENABLE
        int "Minimal allowed value for touch probe readout (0-16384)"
        default 20
        help
            Lower value than this is considered invalid and ignored.

    config HW_SOIL_PROBE_MAX
        depends on HW_SOIL_PROBE_ENABLE
        int "Maximal allowed value for touch probe readout (0-16384)"
        default 800
        help
            Higher value than this is considered invalid and ignored.

    config HW_SOIL_PROBE_LOW
        depends on HW_SOIL_PROBE_ENABLE
        int "Threshold for dry soil (16384-0)"
        default 650
        help
            Value above which value is considered completely dry.
            Note that this value is inverted - high means dry.

    config HW_SOIL_PROBE_HIGH
        depends on HW_SOIL_PROBE_ENABLE
        int "Threshold for wet soil (16384-0)"
        default 120
        help
            Value below which value is considered completely sumberged.
            Note that this value is inverted - low means wet.

    # Water level sensor
    menuconfig HW_WATER_LEVEL_ENABLE
        bool "Water Level Sensor"
        default y

    config HW_WATER_LEVEL_POWER_PIN
        depends on HW_WATER_LEVEL_ENABLE
        int "Power-up water level sensors pin"
        default 25
        help
            Pin, which powers the water level and soil humidity sensors.

    config HW_WATER_LEVEL_DELAY_MS
        depends on HW_WATER_LEVEL_ENABLE
        int "Delay to stabilize water-level sensor readouts."
        default 200
        help
            Delay after sensor power-up or any other manipulation, to charge
            capacitors and provide stable reading.

    config HW_WATER_LEVEL_ADC1_CHANNEL
        depends on HW_WATER_LEVEL_ENABLE
        int "Water level sensor ADC1 channel"
        default 5
        help
            Look in docs, what channel corresponds to which pin.

    config HW_WATER_LEVEL_MIN
        depends on HW_WATER_LEVEL_ENABLE
        int "Minimal allowed value for ADC raw readout (0-4095)"
        default 1000
        help
            Lower value than this is considered invalid and ignored.
            Irrigation is disabled for invalid values.

    config HW_WATER_LEVEL_MAX
        depends on HW_WATER_LEVEL_ENABLE
        int "Maximal allowed value for ADC raw readout (0-4095)"
        default 3500
        help
            Higher value than this is considered invalid and ignored.
            Irrigation is disabled for invalid values.

    config HW_WATER_LEVEL_LOW
        depends on HW_WATER_LEVEL_ENABLE
        int "Threshold for 25% water level (0-4095)"
        default 1500
        help
            Threshold for ADC raw value, when level is considered submerged, in 12-bit (0-4095).
            0% water level is anything below this value.

    config HW_WATER_LEVEL_HIGH
        depends on HW_WATER_LEVEL_ENABLE
        int "Threshold for 100% water level (0-4095)"
        default 2850
        help
            Threshold for ADC raw value, when level is considered submerged, in 12-bit (0-4095).
            100% water level is anything above this value.
endmenu

menu "Irrigation control"
    depends on HW_VALVE_ENABLE

    config IRRIGATION_CRON_EXPRESSION
        string "Irrigation CRON expression"
        default "10 0 */2 * * ?"
        help
            Standard CRON expression, in format "s h m d M wd".

    config IRRIGATION_MAX_LENGTH_SECONDS
        int "Irrigation maximum length, in seconds"
        default 120
        help
            Irrigation is stopped after given number of seconds, even if high water threshold is not met.

    config IRRIGATION_WATER_LEVEL_LOW_PERCENT
        depends on HW_WATER_LEVEL_ENABLE
        int "Low-water level threshold (0-100)"
        default 0
        help
            Irrigation won't start, if water does not fall below this value.

    config IRRIGATION_WATER_LEVEL_HIGH_PERCENT
        depends on HW_WATER_LEVEL_ENABLE
        int "High-water level threshold (0-100)"
        default 100
        help
            Irrigation will stop at this water level.

    comment "Water level sensor disabled, irrigation will be started on given schedule, without any conditions"
        depends on !HW_WATER_LEVEL_ENABLE
endmenu

# ADC1 channel 0 is GPIO36 (ESP32), GPIO1 (ESP32-S2)
# ADC1 channel 1 is GPIO37 (ESP32), GPIO2 (ESP32-S2)
# ADC1 channel 2 is GPIO38 (ESP32), GPIO3 (ESP32-S2)
# ADC1 channel 3 is GPIO39 (ESP32), GPIO4 (ESP32-S2)
# ADC1 channel 4 is GPIO32 (ESP32), GPIO5 (ESP32-S2)
# ADC1 channel 5 is GPIO33 (ESP32), GPIO6 (ESP32-S2)
# ADC1 channel 6 is GPIO34 (ESP32), GPIO7 (ESP32-S2)
# ADC1 channel 7 is GPIO35 (ESP32), GPIO8 (ESP32-S2)

# Touch pad channel 0 is GPIO4(ESP32)
# Touch pad channel 1 is GPIO0(ESP32) / GPIO1(ESP32-S2)
# Touch pad channel 2 is GPIO2(ESP32) / GPIO2(ESP32-S2)
# Touch pad channel 3 is GPIO15(ESP32) / GPIO3(ESP32-S2)
# Touch pad channel 4 is GPIO13(ESP32) / GPIO4(ESP32-S2)
# Touch pad channel 5 is GPIO12(ESP32) / GPIO5(ESP32-S2)
# Touch pad channel 6 is GPIO14(ESP32) / GPIO6(ESP32-S2)
# Touch pad channel 7 is GPIO27(ESP32) / GPIO7(ESP32-S2)
# Touch pad channel 8 is GPIO33(ESP32) / GPIO8(ESP32-S2)
# Touch pad channel 9 is GPIO32(ESP32) / GPIO9(ESP32-S2)
# Touch pad channel 10 is GPIO10(ESP32-S2)
# Touch pad channel 11 is GPIO11(ESP32-S2)
# Touch pad channel 12 is GPIO12(ESP32-S2)
# Touch pad channel 13 is GPIO13(ESP32-S2)
# Touch pad channel 14 is GPIO14(ESP32-S2)
```
